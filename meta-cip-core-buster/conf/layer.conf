## meta-cip-core-buster/conf/layer.conf
```bitbake
#
# CIP Core tiny profile
# Layer configuration for Debian 10 buster userland
#
# Copyright (c) 2019 TOSHIBA Corp.
#
# SPDX-License-Identifier: MIT
#

BBPATH .= ":${LAYERDIR}"
BBFILES += " \
	${LAYERDIR}/recipes-*/*/*.bb \
	${LAYERDIR}/recipes-*/*/*.bbappend \
"

BBFILE_COLLECTIONS += "cip-core-buster"
BBFILE_PATTERN_cip-core-buster = "^${LAYERDIR}/"
BBFILE_PRIORITY_cip-core-buster = "1"

LAYERVERSION_cip-core-buster = "1"
LAYERDEPENDS_cip-core-buster = "core debian"
LAYERSERIES_COMPAT_cip-core-buster = "warrior"
```
